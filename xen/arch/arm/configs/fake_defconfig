## xen/arch/arm/configs/fake_defconfig
```kconfig
CONFIG_BOOT_TIME_CPUPOOLS=y
CONFIG_DEBUG=y
CONFIG_DEBUG_TRACE=y
CONFIG_EARLY_UART_CHOICE_PL011=y
CONFIG_EARLY_UART_BASE_ADDRESS=0x20000000
CONFIG_EARLY_UART_PL011_BAUD_RATE=115200
```
